/* Include the default DT from the kernel */
#include "socfpga_arria10_socdk_mw.dtsi" 

#define fpga_ref_clk  maxv_clk_50m 

#include "socfpga-mw-fpga-bridge.dtsi"
#include "socfpga-mw-mwipcore.dtsi"
/ {
    	chosen {
		bootargs = "console=ttyS0,115200 root=/dev/mmcblk0p3 rw rootwait earlyprintk";
	};
};

/delete-node/ &fpga2sdram0;
 
/* FPGA-to-HPS IRQ starts at 0x13 for Arria 10 SoC */ 
#define MW_DMA_MM2S_IRQ_SELECT  0x13 
#define MW_DMA_S2MM_IRQ_SELECT  0x14 

