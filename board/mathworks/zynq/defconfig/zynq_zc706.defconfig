## package/mathworks/altera-preloader/Config.in
```kconfig
config BR2_PACKAGE_ALTERA_PRELOADER
	bool "Altera Preloader"
	depends on !BR2_PACKAGE_UBOOT_ALTERA_SPL
	help
	  Build Altera Preloader Based on Quartus handoff files

if BR2_PACKAGE_ALTERA_PRELOADER
menu "Altera Preloader Options"

config BR2_PACKAGE_ALTERA_PRELOADER_EDS_VERSION
	string "Altera SoC EDS Version"
    default 14.0.2
	help
	  The version of Altera SoC EDS being used

config BR2_PACKAGE_ALTERA_PRELOADER_BOARDNAME
	string "Altera Preloader board name"
	default BR2_PACKAGE_UBOOT_ALTERA_BOARDNAME if BR2_PACKAGE_UBOOT_ALTERA
	default BR2_TARGET_UBOOT_BOARDNAME if BR2_TARGET_UBOOT
	default "socfpga_cyclone5" \
		if !BR2_TARGET_UBOOT && !BR2_PACKAGE_UBOOT_ALTERA
	help
	  The target board configuration to be built

config BR2_PACKAGE_ALTERA_PRELOADER_QUARTUS_HANDOFF_DIR
	string "Quartus Handoff Files Location"
	help
	  The location of the Quartus handoff files generated during
	  fpga image compilation

	  This can be an absolute path, or relative to the buildroot
	  root directory.

config BR2_PACKAGE_ALTERA_PRELOADER_EDS_INSTALLATION
	string "Path Altera SoC EDS"
	default "/opt/altera/14.0/embedded"
	help
	  This is the path to the Altera SoC EDS installation.
	  
	  For example /opt/altera/14.0/embedded

config BR2_PACKAGE_ALTERA_PRELOADER_UBOOT_CUSTOM_TARBALL
	string "Custom U-Boot tarball"
	default ""
	help
	  Custom U-boot tarball to use for generating the preloader

config BR2_PACKAGE_ALTERA_PRELOADER_BSP_OPTIONS
	string "Options for EDS BSP Generator"
	default ""
	help
	  Extra options to pass to the bsp-create-settings tool
	  Should be in the format:
	      --set <OPTION1> <VALUE1> ... --set <OPTIONN> <VALUEN>

endmenu #"Altera Preloader Options"
endif #BR2_PACKAGE_ALTERA_PRELOADER
```

## package/mathworks/recovery-image/Config.in
```kconfig
config BR2_PACKAGE_RECOVERY_IMAGE
	bool "Build Recovery RAMDisk Image"
	help
	  Build ramdisk image to faciliate system recovery/update

if BR2_PACKAGE_RECOVERY_IMAGE
menu "Recovery Image Options"

choice
	prompt "Recovery Image Specification"
	default BR2_PACKAGE_RECOVERY_IMAGE_USE_BRDPLT

config BR2_PACKAGE_RECOVERY_IMAGE_USE_CATALOG
	bool "Use a catalog.xml file"
	help
	  Run the build tool as:
	  build.py -c <catalog file>

config BR2_PACKAGE_RECOVERY_IMAGE_USE_BRDPLT
	bool "Use a board / platform specification"
	help
	  Run the build tool as:
	  build.py -b <board> -p <platform>

endchoice

if BR2_PACKAGE_RECOVERY_IMAGE_USE_BRDPLT
config BR2_PACKAGE_RECOVERY_IMAGE_PLATFORM
	string "Recovery Image Platform"
	help
	  The platform to use for recovery image selection

config BR2_PACKAGE_RECOVERY_IMAGE_BOARD
	string "Recovery Image Board"
	help
	  The platform to use for recovery image selection

endif #BR2_PACKAGE_RECOVERY_IMAGE_USE_BRDPLT

if BR2_PACKAGE_RECOVERY_IMAGE_USE_CATALOG
config BR2_PACKAGE_RECOVERY_IMAGE_CATALOG
	string "Recovery Image Catalog File Path"
	help
	  The platform to use for recovery image selection
endif #BR2_PACKAGE_RECOVERY_IMAGE_USE_CATALOG

config BR2_PACKAGE_RECOVERY_IMAGE_FILE
	string "Recovery Image File"
	default "uramdisk_recovery.image.gz"
	help
	  The name of the generated recovery image

endmenu #"Recovery Image Options"
endif #BR2_PACKAGE_RECOVERY_IMAGE
```

## package/mathworks/toolchain-customization/Config.in
```kconfig
menu "Toolchain Customization"

config BR2_PACKAGE_TOOLCHAIN_CUSTOMIZATION_COPY_ARCH_LD
	bool "Copy arch-specific ld-*.so.*"
	depends on BR2_TOOLCHAIN_EXTERNAL_CUSTOM
	help
	  Select this option if your external toolchain needs to copy an
	  arch specific ld-*.so.* file

if BR2_PACKAGE_TOOLCHAIN_CUSTOMIZATION_COPY_ARCH_LD

config BR2_PACKAGE_TOOLCHAIN_CUSTOMIZATION_ARCH_LD
	string "Arch-specific ld-*.so.*"
	default ""
	depends on BR2_TOOLCHAIN_EXTERNAL_CUSTOM
	help
	  Select this option if your external toolchain needs to copy an
	  arch specific ld-*.so.* file

endif #BR2_PACKAGE_TOOLCHAIN_CUSTOMIZATION_COPY_ARCH_LD

endmenu
```

## package/mathworks/uboot-altera/Config.in
```kconfig
config BR2_PACKAGE_UBOOT_ALTERA
	bool "Altera U-Boot Modifications"
	depends on BR2_TARGET_UBOOT
	help
	  Build Altera Preloader Based on Quartus handoff files

if BR2_PACKAGE_UBOOT_ALTERA
menu "Altera U-Boot Options"

config BR2_PACKAGE_UBOOT_ALTERA_QUARTUS_HANDOFF_DIR
	string "Quartus Handoff Files Location"
	help
	  The location of the Quartus handoff files generated during
	  fpga image compilation

	  This can be an absolute path, or relative to the buildroot
	  root directory.

config BR2_PACKAGE_UBOOT_ALTERA_GENERATE_ARRIA10_UBOOT
	bool "Generate DTS and bootloader for Arria 10 SoC"
	default n
	help
	  Generate the U-boot based on the Quartus U-boot directory.
	  
	  If selected, buildroot will generate U-boot files using the SoC
	  EDS tools. The handoff directory should contain only the output
	  of the Quartus hps_isw_handoff folder.
	  

config BR2_PACKAGE_UBOOT_ALTERA_GENERATE_BSP
	bool "Generate BSP Files"
	default y
	help
	  Generate the BSP files based on the Quartus handoff directory.
	  
	  If selected, buildroot will generate BSP files using the SoC
	  EDS tools. The handoff directory should contain only the output
	  of the Quartus hps_isw_handoff folder.
	  
	  If not selected, you must supply both the Quartus handoff
	  files and the generated BSP files. The handoff directory should
	  contain two subdirectories: "handoff" with the Quartus
	  hps_isw_handoff contents and "generated" with the BSP contents.

if BR2_PACKAGE_UBOOT_ALTERA_GENERATE_BSP
config BR2_PACKAGE_UBOOT_ALTERA_EDS_INSTALLATION
	string "Path Altera SoC EDS"
	default "/opt/altera/14.0/embedded"
	help
	  This is the path to the Altera SoC EDS installation.
	  
	  For example /opt/altera/14.0/embedded

config BR2_PACKAGE_UBOOT_ALTERA_BSP_OPTIONS
	string "Options for EDS BSP Generator"
	default ""
	help
	  Extra options to pass to the bsp-create-settings tool
	  Should be in the format:
	      --set <OPTION1> <VALUE1> ... --set <OPTIONN> <VALUEN>

endif #BR2_PACKAGE_UBOOT_ALTERA_GENERATE_BSP
endmenu #"Altera U-Boot Options"
endif #BR2_PACKAGE_UBOOT_ALTERA
```

## package/mathworks/uboot-tgt-tools/Config.in.host
```kconfig
config BR2_PACKAGE_HOST_UBOOT_TGT_TOOLS
	bool "host u-boot tools"
    depends on !BR2_PACKAGE_HOST_UBOOT_TOOLS
	help
	  Companion tools for Das U-Boot bootloader.

	  http://www.denx.de/wiki/U-Boot/WebHome
```

## package/mathworks/uboot-xilinx/Config.in
```kconfig
config BR2_PACKAGE_UBOOT_XILINX
	bool "Xilinx U-Boot Modifications"
	depends on BR2_TARGET_UBOOT
	help
	  Build SPL based on Vivado handoff files

if BR2_PACKAGE_UBOOT_XILINX
menu "Xilinx U-Boot Options"

config BR2_PACKAGE_UBOOT_XILINX_VIVADO_HANDOFF_DIR
	string "Vivado Handoff Files Location"
	help
	  The location of the Vivado handoff files generated during
	  fpga image compilation

	  This can be an absolute path, or relative to the buildroot
	  root directory.

config BR2_PACKAGE_UBOOT_XILINX_UBOOT_TARGET_DIR
	string "U-Boot Target Directory"
	default "board/xilinx/zynq/zynq-zed"
	help
	  The locationin the U-Boot tree to copy the handoff files

endmenu #"Xilinx U-Boot Options"
endif #BR2_PACKAGE_UBOOT_XILINX
```

## package/mathworks/xilinx-bootloader/Config.in
```kconfig
config BR2_PACKAGE_XILINX_BOOTLOADER
	bool "Xilinx Bootloader Configuration"
	depends on BR2_TARGET_UBOOT
	depends on (BR2_aarch64 \
			&& (BR2_TARGET_UBOOT_FORMAT_BIN \
			|| BR2_TARGET_UBOOT_FORMAT_ELF)) \
		|| (BR2_arm \
			&& (BR2_TARGET_UBOOT_FORMAT_IMG \
			|| BR2_TARGET_UBOOT_FORMAT_ELF))
	help
	  Build SPL based on Vivado handoff files

if BR2_PACKAGE_XILINX_BOOTLOADER
menu "Xilinx Bootloader Options"

choice
	prompt "Xilinx FSBL Type"
	help
	  Select the type of FSBL to use

config BR2_PACKAGE_XILINX_BOOTLOADER_FSBL_SDK
	bool "SDK FSBL"
	depends on BR2_TARGET_UBOOT_FORMAT_ELF

config BR2_PACKAGE_XILINX_BOOTLOADER_UBOOT_SPL
	bool "U-Boot SPL"
	depends on (BR2_TARGET_UBOOT_FORMAT_BIN \
		|| BR2_TARGET_UBOOT_FORMAT_IMG)
	depends on BR2_TARGET_UBOOT_SPL

endchoice

config BR2_PACKAGE_XILINX_BOOTLOADER_PLATFORM
	string
	default "zynq"		if BR2_arm
	default "zynqmp"	if BR2_aarch64

config BR2_PACKAGE_XILINX_BOOTLOADER_PMUFW
	bool "Include PMU Firmware in boot.bin"
	depends on BR2_aarch64
	help
	  Build the PMU Firmware into the boot.bin file

config BR2_PACKAGE_XILINX_BOOTLOADER_PMUFW_PATH
	string "PMU Firmware"
	depends on BR2_PACKAGE_XILINX_BOOTLOADER_PMUFW
	help
	  Path to the PMU firmware binary.
	  
	  If using the Vivado FSBL, this should be the elf file generated
	  by Vivado SDK
	  
	  If using the U-Boot SPL, this file should be generated by
	  running "mb-objcopy -O binary" on the firmware elf file generated
	  by Vivado SDK

if BR2_PACKAGE_XILINX_BOOTLOADER_FSBL_SDK

config BR2_PACKAGE_XILINX_BOOTLOADER_BOOTGEN_PATH
	string "Xilinx bootgen path"
	default "/opt/Xilinx/SDK/2018.2/bin/bootgen"
	help
	  Path to the Xilinx bootgen tool

config BR2_PACKAGE_XILINX_BOOTLOADER_FSBL_ELF_PATH
	string "FSBL Elf"
	help
	  Path to the FSBL elf file.

endif

if BR2_PACKAGE_XILINX_BOOTLOADER_UBOOT_SPL

config BR2_PACKAGE_XILINX_BOOTLOADER_VIVADO_HANDOFF_DIR
	string "Vivado Handoff Files Location"
	help
	  The location of the Vivado handoff files generated during
	  fpga image compilation

	  This can be an absolute path, or relative to the buildroot
	  root directory.

config BR2_PACKAGE_XILINX_BOOTLOADER_UBOOT_TARGET_DIR
	string "U-Boot Target Directory"
	default "board/xilinx/zynq/zynq-zed"
	help
	  The locationin the U-Boot tree to copy the handoff files

endif

endmenu #"Xilinx U-Boot Options"
endif #BR2_PACKAGE_XILINX_BOOTLOADER
```

## package/rf-init/Config.in
```kconfig
config BR2_PACKAGE_RFINIT
    bool "rf-init"
    default n
    help
    RF init application to send rfdc configuration through tcp.
```

## package/tcf-agent/Config.in
```kconfig
config BR2_PACKAGE_TCF_AGENT
	bool "Eclipse Target Communication Framework (TCF) Agent"
	depends on BR2_aarch64 || BR2_arm || BR2_x86_64
	help
	  Eclipse Target Communication Framework provides a
	  mechansim to remotely debug applications running on the
	  target from the Eclipse IDE.
	  
	  http://www.eclipse.org/tcf/

if BR2_PACKAGE_TCF_AGENT

config BR2_PACKAGE_TCF_AGENT_MACHINE
	string
	default "a64"		 if BR2_aarch64
	default "arm"		if BR2_arm
	default "x86_64"	 if BR2_x86_64

config BR2_PACKAGE_TCF_AGENT_USESSL
	bool "Use SSL in the TCF Agent Build"
	default y
	select BR2_PACKAGE_OPENSSL
	help
	  Enable SSL for the TCF Agent Build

config BR2_PACKAGE_TCF_AGENT_USEUUID
	bool "Use UUIDs in the TCF Agent Build"
	default y
	select BR2_PACKAGE_UTIL_LINUX_LIBUUID
	select BR2_PACKAGE_UTIL_LINUX
	help
	  Enable UUIDs for the TCF Agent Build

endif #BR2_PACKAGE_TCF_AGENT
```

## package/uboot-tgt-tools/Config.in
```kconfig
config BR2_PACKAGE_UBOOT_TGT_TOOLS
	bool "u-boot target-specific tools"
    depends on !BR2_PACKAGE_UBOOT_TOOLS 
	help
	  Companion tools for Das U-Boot bootloader.
	  Makes use of the target config file

	  http://www.denx.de/wiki/U-Boot/WebHome

if BR2_PACKAGE_UBOOT_TGT_TOOLS

config BR2_PACKAGE_UBOOT_TGT_TOOLS_USECUSTOMGIT
    bool "Use Custom Git"
    depends on BR2_TARGET_UBOOT_CUSTOM_GIT
    help
	  Use the custom git repository defined for the bootloader

config BR2_PACKAGE_UBOOT_TGT_TOOLS_MKIMAGE
	bool "mkimage"
	help
	  The mkimage tool from Das U-Boot bootloader, which allows
	  generation of U-Boot images in various formats.

if BR2_PACKAGE_UBOOT_TGT_TOOLS_MKIMAGE

config BR2_PACKAGE_UBOOT_TGT_TOOLS_MKENVIMAGE
	bool "mkenvimage"
	help
	  The mkenvimage tool from Das U-Boot bootloader, which allows
	  generation of a valid binary environment image from a text file
	  describing the key=value pairs of the environment.

config BR2_PACKAGE_UBOOT_TGT_TOOLS_FWPRINTENV
	bool "fw_printenv"
	default y
	help
	  The fw_printenv / fw_setenv tools from Das U-Boot
	  bootloader, which allows access to the U-Boot environment
	  from Linux.

endif

endif
```
