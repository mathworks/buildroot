## board/mathworks/zynq/defconfig/zynq_zc706.defconfig
```kconfig
###########################################
# ZC706 Options
###########################################
BR2_ROOTFS_POST_SCRIPT_ARGS="-b zc706 -a vid-zc70x-imageon"
BR2_TARGET_UBOOT_BOARDNAME="zynq_zc70x"
BR2_LINUX_KERNEL_INTREE_DTS_NAME="zynq-mw-zc706"
```

## board/mathworks/zynq/defconfig/zynq_zed.defconfig
```kconfig
###########################################
# ZedBoard Options
###########################################
BR2_ROOTFS_POST_SCRIPT_ARGS="-b zed -a dma -a fmcomms2 -a vid-imageon -a vid-camlink -a vid-hdmi -a vid-vita -a sound -a axilite -a axistream -a canspi"
BR2_TARGET_UBOOT_BOARDNAME="zynq_zed"
BR2_LINUX_KERNEL_INTREE_DTS_NAME="zynq-mw-zed"
```

## board/mathworks/zynq/defconfig/zynq_zybo.defconfig
```kconfig
###########################################
# ZedBoard Options
###########################################
BR2_ROOTFS_POST_SCRIPT_ARGS="-b zybo"
BR2_TARGET_UBOOT_BOARDNAME="zynq_zybo"
BR2_LINUX_KERNEL_INTREE_DTS_NAME="zynq-mw-zybo"
```

## board/mathworks/zynqmp/boards/zcu111/defconfig
```kconfig
###########################################
# ZCU111 Options
###########################################
BR2_TARGET_UBOOT_BOARD_DEFCONFIG="xilinx_zynqmp_zcu111_revA"
BR2_PACKAGE_XILINX_BOOTLOADER_UBOOT_TARGET_DIR="board/xilinx/zynqmp/zynqmp-zcu111-revA"

BR2_ROOTFS_DEVICE_TABLE="system/device_table.txt board/mathworks/zynqmp/device_table.txt ./board/mathworks/zynqmp/boards/zcu111/device_table.txt"

BR2_ROOTFS_OVERLAY="./board/mathworks/common/fs-overlay ./board/mathworks/zynqmp/fs-overlay ./board/mathworks/zynqmp/boards/zcu111/fs-overlay"

BR2_LINUX_KERNEL_DEFCONFIG="mw_zynqmp_zcu111"

BR2_LINUX_KERNEL_CUSTOM_REPO_URL="https://github.com/mathworks/xilinx-linux.git"
BR2_LINUX_KERNEL_CUSTOM_REPO_VERSION="mathworks_zynq_rfsoc_R23.1.0"

BR2_TARGET_UBOOT_CUSTOM_REPO_URL="https://github.com/mathworks/xilinx-uboot.git"
BR2_TARGET_UBOOT_CUSTOM_REPO_VERSION="mathworks_zynq_rfsoc_R20.2.0"
BR2_TARGET_UBOOT_VERSION="mathworks_zynq_rfsoc_R20.2.0"

BR2_PACKAGE_LIBCONFIG=y
BR2_PACKAGE_LIBSYSFS=y

BR2_PACKAGE_BUSYBOX_SHOW_OTHERS=y
BR2_PACKAGE_BASH=y
BR2_PACKAGE_LTTNG_MODULES=n
BR2_PACKAGE_LTTNG_MODULES_RFSOC=y
```

## board/mathworks/zynqmp/boards/zcu216/defconfig
```kconfig
###########################################
# ZCU216 Options
###########################################
BR2_TARGET_UBOOT_BOARD_DEFCONFIG="xilinx_zynqmp_virt"
BR2_PACKAGE_XILINX_BOOTLOADER_UBOOT_TARGET_DIR="board/xilinx/zynqmp/zynqmp-zcu216-revA"

BR2_ROOTFS_DEVICE_TABLE="system/device_table.txt board/mathworks/zynqmp/device_table.txt ./board/mathworks/zynqmp/boards/zcu216/device_table.txt"

BR2_ROOTFS_OVERLAY="./board/mathworks/common/fs-overlay ./board/mathworks/zynqmp/fs-overlay ./board/mathworks/zynqmp/boards/zcu216/fs-overlay"

BR2_LINUX_KERNEL_DEFCONFIG="mw_zynqmp_zcu216"

BR2_LINUX_KERNEL_CUSTOM_REPO_URL="https://github.com/mathworks/xilinx-linux.git"
BR2_LINUX_KERNEL_CUSTOM_REPO_VERSION="mathworks_zynq_rfsoc_gen3_R23.1.0"

BR2_TARGET_UBOOT_CUSTOM_REPO_URL="https://github.com/mathworks/xilinx-uboot.git"
BR2_TARGET_UBOOT_CUSTOM_REPO_VERSION="mathworks_zynq_rfsoc_gen3_R21.1.0"
BR2_TARGET_UBOOT_VERSION="mathworks_zynq_rfsoc_gen3_R21.1.0"

BR2_PACKAGE_XILINX_BOOTLOADER_PLATFORM="zynqmp_gen3"

BR2_TARGET_ARM_TRUSTED_FIRMWARE=y
BR2_TARGET_ARM_TRUSTED_FIRMWARE_CUSTOM_GIT=y
BR2_TARGET_ARM_TRUSTED_FIRMWARE_CUSTOM_REPO_URL="https://github.com/Xilinx/arm-trusted-firmware.git"
BR2_TARGET_ARM_TRUSTED_FIRMWARE_CUSTOM_REPO_VERSION="xilinx-v2020.1"
BR2_TARGET_ARM_TRUSTED_FIRMWARE_PLATFORM="zynqmp"
BR2_TARGET_ARM_TRUSTED_FIRMWARE_ADDITIONAL_VARIABLES="RESET_TO_BL31=1"


BR2_PACKAGE_LIBCONFIG=y
BR2_PACKAGE_LIBSYSFS=y

BR2_PACKAGE_BUSYBOX_SHOW_OTHERS=y
BR2_PACKAGE_BASH=y
BR2_PACKAGE_LTTNG_MODULES=n
BR2_PACKAGE_LTTNG_MODULES_RFSOC=n
BR2_PACKAGE_LTTNG_MODULES_2_11_6=y
```

## board/mathworks/zynqmp/defconfig/common.defconfig
```kconfig
###########################################
# Platform Options
###########################################
#include "aarch64_common.defconfig"
#ifdef BUILD_MODE_NORMAL
BR2_LINUX_KERNEL_CUSTOM_REPO_URL="https://github.com/mathworks/xilinx-linux.git"
BR2_LINUX_KERNEL_CUSTOM_REPO_VERSION="mathworks_zynq_vision_R23.1.0"
BR2_LINUX_KERNEL_UIMAGE=y
BR2_LINUX_KERNEL_UIMAGE_LOADADDR="0x8000"
#endif
BR2_ROOTFS_DEVICE_TABLE="system/device_table.txt board/mathworks/zynqmp/device_table.txt"
BR2_ROOTFS_OVERLAY="./board/mathworks/common/fs-overlay ./board/mathworks/zynqmp/fs-overlay"
BR2_ROOTFS_POST_BUILD_SCRIPT="board/mathworks/zynqmp/scripts/postbuild_common.sh"
BR2_TARGET_GENERIC_HOSTNAME="buildroot-zynqmp"
BR2_TARGET_GENERIC_GETTY_PORT="ttyPS0"
BR2_TARGET_GENERIC_ROOT_PASSWD="root"
BR2_TARGET_ROOTFS_CPIO_GZIP=y
BR2_TARGET_ROOTFS_CPIO=y
BR2_TARGET_ROOTFS_CPIO_UIMAGE=y
# BR2_TARGET_ROOTFS_TAR is not set
#ifdef BUILD_MODE_NORMAL
BR2_TARGET_UBOOT=y
BR2_TARGET_UBOOT_BUILD_SYSTEM_KCONFIG=y
BR2_TARGET_UBOOT_NEEDS_DTC=y
BR2_TARGET_UBOOT_NEEDS_OPENSSL=y
BR2_TARGET_UBOOT_CUSTOM_GIT=y
BR2_TARGET_UBOOT_CUSTOM_REPO_URL="https://github.com/mathworks/xilinx-uboot.git"
BR2_TARGET_UBOOT_CUSTOM_REPO_VERSION="mathworks_zynq_vision_R23.1.0"
BR2_TARGET_ARM_TRUSTED_FIRMWARE=y
BR2_TARGET_ARM_TRUSTED_FIRMWARE_CUSTOM_GIT=y
BR2_TARGET_ARM_TRUSTED_FIRMWARE_CUSTOM_REPO_URL="https://github.com/Xilinx/arm-trusted-firmware.git"
BR2_TARGET_ARM_TRUSTED_FIRMWARE_CUSTOM_REPO_VERSION="xilinx-v2018.2"
BR2_TARGET_ARM_TRUSTED_FIRMWARE_PLATFORM="zynqmp"
BR2_TARGET_ARM_TRUSTED_FIRMWARE_ADDITIONAL_VARIABLES="RESET_TO_BL31=1"
BR2_PACKAGE_XILINX_BOOTLOADER=y
BR2_PACKAGE_XILINX_BOOTLOADER_BOOTGEN_PATH="/opt/Xilinx/SDK/2018.2/bin/bootgen"
#endif

BR2_PACKAGE_GSTREAMER1=y
BR2_PACKAGE_GSTREAMER1_PARSE=y
BR2_PACKAGE_GSTREAMER1_PLUGIN_REGISTRY=y
BR2_PACKAGE_GSTREAMER1_INSTALL_TOOLS=y

BR2_PACKAGE_GST1_PLUGINS_BASE=y
BR2_PACKAGE_GST1_PLUGINS_BASE_PLUGIN_ADDER=y
BR2_PACKAGE_GST1_PLUGINS_BASE_PLUGIN_APP=y
BR2_PACKAGE_GST1_PLUGINS_BASE_PLUGIN_ENCODING=y
BR2_PACKAGE_GST1_PLUGINS_BASE_PLUGIN_VIDEOCONVERT=y
BR2_PACKAGE_GST1_PLUGINS_BASE_PLUGIN_SUBPARSE=y
BR2_PACKAGE_GST1_PLUGINS_BASE_PLUGIN_TCP=y
BR2_PACKAGE_GST1_PLUGINS_BASE_PLUGIN_VIDEOTESTSRC=y
BR2_PACKAGE_GST1_PLUGINS_BASE_PLUGIN_VIDEORATE=y
BR2_PACKAGE_GST1_PLUGINS_BASE_PLUGIN_VIDEOSCALE=y

BR2_PACKAGE_GST1_PLUGINS_GOOD=y
BR2_PACKAGE_GST1_PLUGINS_GOOD_JPEG=y
BR2_PACKAGE_GST1_PLUGINS_GOOD_PNG=y
BR2_PACKAGE_GST1_PLUGINS_GOOD_BZ2=y
BR2_PACKAGE_GST1_PLUGINS_GOOD_ZLIB=y
BR2_PACKAGE_GST1_PLUGINS_GOOD_PLUGIN_ALPHA=y
BR2_PACKAGE_GST1_PLUGINS_GOOD_PLUGIN_AUPARSE=y
BR2_PACKAGE_GST1_PLUGINS_GOOD_PLUGIN_AUTODETECT=y
BR2_PACKAGE_GST1_PLUGINS_GOOD_PLUGIN_AVI=y
BR2_PACKAGE_GST1_PLUGINS_GOOD_PLUGIN_CUTTER=y
BR2_PACKAGE_GST1_PLUGINS_GOOD_PLUGIN_DEBUGUTILS=y
BR2_PACKAGE_GST1_PLUGINS_GOOD_PLUGIN_DEINTERLACE=y
BR2_PACKAGE_GST1_PLUGINS_GOOD_PLUGIN_DTMF=y
BR2_PACKAGE_GST1_PLUGINS_GOOD_PLUGIN_EFFECTV=y
BR2_PACKAGE_GST1_PLUGINS_GOOD_PLUGIN_FLV=y
BR2_PACKAGE_GST1_PLUGINS_GOOD_PLUGIN_FLX=y
BR2_PACKAGE_GST1_PLUGINS_GOOD_PLUGIN_GOOM=y
BR2_PACKAGE_GST1_PLUGINS_GOOD_PLUGIN_GOOM2K1=y
BR2_PACKAGE_GST1_PLUGINS_GOOD_PLUGIN_IMAGEFREEZE=y
BR2_PACKAGE_GST1_PLUGINS_GOOD_PLUGIN_ISOMP4=y
BR2_PACKAGE_GST1_PLUGINS_GOOD_PLUGIN_MONOSCOPE=y
BR2_PACKAGE_GST1_PLUGINS_GOOD_PLUGIN_MULTIFILE=y
BR2_PACKAGE_GST1_PLUGINS_GOOD_PLUGIN_MULTIPART=y
BR2_PACKAGE_GST1_PLUGINS_GOOD_PLUGIN_RTP=y
BR2_PACKAGE_GST1_PLUGINS_GOOD_PLUGIN_RTPMANAGER=y
BR2_PACKAGE_GST1_PLUGINS_GOOD_PLUGIN_RTSP=y
BR2_PACKAGE_GST1_PLUGINS_GOOD_PLUGIN_SHAPEWIPE=y
BR2_PACKAGE_GST1_PLUGINS_GOOD_PLUGIN_SMPTE=y
BR2_PACKAGE_GST1_PLUGINS_GOOD_PLUGIN_UDP=y
BR2_PACKAGE_GST1_PLUGINS_GOOD_PLUGIN_VIDEOBOX=y
BR2_PACKAGE_GST1_PLUGINS_GOOD_PLUGIN_VIDEOCROP=y
BR2_PACKAGE_GST1_PLUGINS_GOOD_PLUGIN_VIDEOFILTER=y
BR2_PACKAGE_GST1_PLUGINS_GOOD_PLUGIN_VIDEOMIXER=y
BR2_PACKAGE_GST1_PLUGINS_GOOD_PLUGIN_Y4M=y
BR2_PACKAGE_GST1_PLUGINS_GOOD_PLUGIN_V4L2=y
BR2_PACKAGE_GST1_PLUGINS_GOOD_PLUGIN_V4L2_PROBE=y
BR2_PACKAGE_GST1_PLUGINS_GOOD_PLUGIN_GDKPIXBUF=y
BR2_PACKAGE_GST1_PLUGINS_GOOD_PLUGIN_VPX=y

BR2_PACKAGE_YAVTA=y
```

## board/mathworks/zynqmp/defconfig/linaro.defconfig
```kconfig
###########################################
# Linaro Toolchain Options
###########################################
BR2_TOOLCHAIN_EXTERNAL_CUSTOM=y
BR2_TOOLCHAIN_EXTERNAL_PREINSTALLED=y
BR2_TOOLCHAIN_EXTERNAL_PATH="/opt/linaro/5.3-2016.02/aarch64-linux-gnu"
BR2_TOOLCHAIN_EXTERNAL_CUSTOM_PREFIX="$(ARCH)-linux-gnu"
BR2_TOOLCHAIN_EXTERNAL_CUSTOM_GLIBC=y
BR2_PACKAGE_TOOLCHAIN_CUSTOMIZATION_PREFIX_SYMLINK=y
BR2_INSTALL_LIBSTDCPP=y
BR2_TOOLCHAIN_HAS_SSP=y
BR2_TOOLCHAIN_HAS_FORTRAN=y
BR2_TOOLCHAIN_HAS_NATIVE_RPC=y
BR2_TOOLCHAIN_EXTERNAL_GCC_5=y
BR2_TOOLCHAIN_EXTERNAL_CXX=y
BR2_TOOLCHAIN_EXTERNAL_HEADERS_4_0=y
```

## board/mathworks/zynqmp/defconfig/linux.defconfig
```kconfig
###########################################
# Linux Options
###########################################
BR2_LINUX_KERNEL_DEFCONFIG="mw_zynqmp"
BR2_LINUX_KERNEL_CONFIG_FRAGMENT_FILES="$(shell printenv BR2_LINUX_KERNEL_CONFIG_FRAGMENT_FILES) board/mathworks/zynqmp/kernel-frags/iio_dummy.frag"
```

## boot/atfirmware/Config.in
```kconfig
config BR2_TARGET_ATFIRMWARE
	bool "ARM Trusted Firmware (ATF)"
	depends on BR2_aarch64 && BR2_TARGET_UBOOT
	select BR2_TARGET_SCPFIRMWARE if BR2_TARGET_ATFIRMWARE_PLATFORM='juno'
	help
	  Enable this option if you want to build the ATF for your ARM based
	  embedded device.

if BR2_TARGET_ATFIRMWARE
choice
	prompt "version"
	help
	  Select the specific ATF version you want to use

config BR2_TARGET_ATFIRMWARE_LATEST_VERSION
	bool "v1.2"

config BR2_TARGET_ATFIRMWARE_CUSTOM_TARBALL
	bool "Custom tarball"

config BR2_TARGET_ATFIRMWARE_CUSTOM_GIT
	bool "Custom Git repository"

endchoice

if BR2_TARGET_ATFIRMWARE_CUSTOM_TARBALL

config BR2_TARGET_ATFIRMWARE_CUSTOM_TARBALL_LOCATION
	string "URL of custom ARM Trusted Firmware tarball"

endif

config BR2_TARGET_ATFIRMWARE_VERSION
	string
	default "v1.2"	if BR2_TARGET_ATFIRMWARE_LATEST_VERSION
	default "custom"	if BR2_TARGET_ATFIRMWARE_CUSTOM_TARBALL
	default BR2_TARGET_ATFIRMWARE_CUSTOM_GIT_VERSION if BR2_TARGET_ATFIRMWARE_CUSTOM_GIT

config BR2_TARGET_ATFIRMWARE_CUSTOM_PATCH_DIR
	string "Custom patch dir"
	help
	  If your ATF requires custom patches, add the path to the
	  directory containing the patches here.

if BR2_TARGET_ATFIRMWARE_CUSTOM_GIT

config BR2_TARGET_ATFIRMWARE_CUSTOM_GIT_REPO_URL
	string "URL of custom Git repository"

config BR2_TARGET_ATFIRMWARE_CUSTOM_GIT_VERSION
	string "Custom Git version"
	help
	  Revision to use in the typical format used by Git
	  E.G. a sha id, a tag, ..

endif

config BR2_TARGET_ATFIRMWARE_PLATFORM
	string "Name of ATF platform to build for"
	help
	  Target plaform to build for.
	  E.G. If using ARM Juno, please type 'juno'

config BR2_TARGET_ATFIRMWARE_ADDITIONAL_VARIABLES
	string "Additional ATF build variables"
	help
	  Additional parameters for the ATF build
	  E.G. 'DEBUG=1 LOG_LEVEL=20'

endif
```

## configs/zynq_mathworks_defconfig
```kconfig
BR2_arm=y
BR2_cortex_a9=y
BR2_ARM_EABIHF=y
BR2_ARM_ENABLE_NEON=y
BR2_ARM_FPU_VFPV3D16=y
BR2_TOOLCHAIN_EXTERNAL=y
BR2_TOOLCHAIN_EXTERNAL_LINARO_2013_05=y
BR2_TOOLCHAIN_EXTERNAL_PREINSTALLED=y
BR2_TOOLCHAIN_EXTERNAL_PATH="/opt/xtools/linaro-2013.05"
BR2_TOOLCHAIN_EXTERNAL_GDB_SERVER_COPY=y
BR2_ENABLE_LOCALE_PURGE=y
BR2_ENABLE_LOCALE_WHITELIST="C en_US"
BR2_ROOTFS_DEVICE_CREATION_DYNAMIC_MDEV=y
BR2_ROOTFS_DEVICE_TABLE="system/device_table.txt board/mathworks/zynq/device_table.txt"
BR2_TARGET_GENERIC_GETTY_PORT="ttyPS0"
# BR2_TARGET_GENERIC_REMOUNT_ROOTFS_RW is not set
BR2_ROOTFS_OVERLAY="./board/mathworks/zynq/fs-overlay"
BR2_ROOTFS_POST_IMAGE_SCRIPT="board/mathworks/zynq/postbuild.sh"
BR2_PACKAGE_BUSYBOX_CONFIG="board/mathworks/zynq/busybox_config"
BR2_PACKAGE_OPENSSH=y
BR2_PACKAGE_XINETD=y
BR2_TARGET_ROOTFS_CPIO=y
BR2_TARGET_ROOTFS_CPIO_GZIP=y
# BR2_TARGET_ROOTFS_TAR is not set
BR2_PACKAGE_HOST_E2FSPROGS=y
BR2_PACKAGE_HOST_GENEXT2FS=y
```

## configs/zynq_mw_zc706_xenomai_linaro_defconfig
```kconfig
###########################################
# Common Options
###########################################
BR2_arm=y
BR2_cortex_a9=y
BR2_ARM_ENABLE_NEON=y
BR2_ARM_FPU_NEON=y
BR2_TOOLCHAIN_EXTERNAL=y
BR2_TOOLCHAIN_EXTERNAL_GDB_SERVER_COPY=y
BR2_ENABLE_LOCALE_PURGE=y
BR2_ENABLE_LOCALE_WHITELIST="C en_US"
BR2_ROOTFS_DEVICE_CREATION_DYNAMIC_MDEV=y
BR2_ROOTFS_DEVICE_TABLE="system/device_table.txt board/mathworks/zynq/device_table.txt"
BR2_TARGET_GENERIC_GETTY_PORT="ttyPS0"
# BR2_TARGET_GENERIC_REMOUNT_ROOTFS_RW is not set
BR2_ROOTFS_OVERLAY="./board/mathworks/zynq/fs-overlay"
BR2_LINUX_KERNEL=y
BR2_LINUX_KERNEL_CUSTOM_GIT=y
BR2_LINUX_KERNEL_CUSTOM_GIT_REPO_URL="https://bitbucket.org/mfornero/ipipe.git"
BR2_LINUX_KERNEL_UIMAGE_LOADADDR="0x8000"
BR2_LINUX_KERNEL_DTS_SUPPORT=y
BR2_LINUX_KERNEL_INTREE_DTS_NAME="zynq-mw-zc702 zynq-mw-zc706 zynq-mw-zed"
BR2_PACKAGE_BUSYBOX_CONFIG="board/mathworks/zynq/busybox_config"
BR2_PACKAGE_DTC=y
BR2_PACKAGE_DTC_PROGRAMS=y
BR2_PACKAGE_OPENSSH=y
BR2_PACKAGE_XINETD=y
BR2_TARGET_ROOTFS_CPIO=y
BR2_TARGET_ROOTFS_CPIO_GZIP=y
# BR2_TARGET_ROOTFS_TAR is not set
BR2_TARGET_UBOOT=y
BR2_TARGET_UBOOT_CUSTOM_GIT=y
BR2_TARGET_UBOOT_CUSTOM_GIT_REPO_URL="git://github.com/Xilinx/u-boot-xlnx.git"
BR2_TARGET_UBOOT_CUSTOM_GIT_VERSION="xilinx-v14.4"
BR2_TARGET_UBOOT_FORMAT_ELF=y
BR2_PACKAGE_HOST_E2FSPROGS=y
BR2_PACKAGE_HOST_GENEXT2FS=y
###########################################
# ZC706 Options
###########################################
BR2_ROOTFS_POST_IMAGE_SCRIPT="board/mathworks/zynq/scripts/postbuild_zc706.sh"
BR2_TARGET_UBOOT_BOARDNAME="zynq_zc70x"
###########################################
# Linaro Toolchain Options
###########################################
BR2_TOOLCHAIN_EXTERNAL_LINARO_2013_04=y
BR2_TOOLCHAIN_EXTERNAL_PREINSTALLED=y
BR2_TOOLCHAIN_EXTERNAL_PATH="/opt/xtools/linaro-2012.05"
BR2_ARM_EABIHF=y
###########################################
# Xenomai Options
###########################################
BR2_LINUX_KERNEL_CUSTOM_GIT_VERSION="master"
BR2_LINUX_KERNEL_DEFCONFIG="xenomai_zynq"
BR2_LINUX_KERNEL_EXT_XENOMAI=y
# BR2_PACKAGE_XENOMAI_DOCS is not set
BR2_PACKAGE_XENOMAI_TESTSUITE=y
BR2_PACKAGE_XENOMAI_VXWORKS_SKIN=y
```

## package/cots-tcp/Config.in
```kconfig
config BR2_PACKAGE_COTS-TCP
bool "cots-tcp"
default n
help
Avinet cots-tcp applicaiton.
```

## package/fru-tools/Config.in
```kconfig
config BR2_PACKAGE_FRU_TOOLS
        bool "fru-tools"
        help
          Tool to dump and program FRU EEPROMs

          https://github.com/analogdevicesinc/fru_tools
```

## package/mathworks/Config.in
```kconfig
menu "Target packages"
	source "package/mathworks/uboot-altera/Config.in"
	source "package/mathworks/xilinx-bootloader/Config.in"
	source "package/mathworks/recovery-image/Config.in"
	source "package/mathworks/toolchain-customization/Config.in"
endmenu
source "package/mathworks/Config.in.host"
```
