## board/mathworks/zynq/boards/mitx-7z045/defconfig
```kconfig
###########################################
# mITX 7z045 Options
###########################################
BR2_ROOTFS_POST_SCRIPT_ARGS="-b mitx -c 7z045 -a vid-camlink -a vid-imageon -a vid-hdmi"
BR2_TARGET_UBOOT_BOARDNAME="zynq_zc70x"
```

## board/mathworks/zynq/boards/picozed/defconfig
```kconfig
###########################################
# PicoZed Options
###########################################
BR2_TARGET_UBOOT_BOARD_DEFCONFIG="zynq_picozed"
BR2_PACKAGE_XILINX_BOOTLOADER_UBOOT_TARGET_DIR="board/xilinx/zynq/"
```

## board/mathworks/zynq/boards/pzsdr/defconfig
```kconfig
###########################################
# PicoZed SDR Options
###########################################
BR2_TARGET_UBOOT_BOARD_DEFCONFIG="zynq_picozed_sdr2"
BR2_PACKAGE_UBOOT_XILINX_UBOOT_TARGET_DIR="board/xilinx/zynq/zynq-picozed-sdr2"
```

## board/mathworks/zynq/boards/uzed-7z010/defconfig
```kconfig
###########################################
# ZedBoard Options
###########################################
BR2_ROOTFS_POST_SCRIPT_ARGS="-p zynq -b uzed-7z010"
BR2_TARGET_UBOOT_BOARDNAME="zynq_microzed"
```

## board/mathworks/zynq/boards/uzed-7z020/defconfig
```kconfig
###########################################
# ZedBoard Options
###########################################
BR2_ROOTFS_POST_SCRIPT_ARGS="-p zynq -b uzed-7z020"
BR2_TARGET_UBOOT_BOARDNAME="zynq_uzed"
```

## board/mathworks/zynq/boards/uzed/defconfig
```kconfig
###########################################
# ZedBoard Options
###########################################
BR2_ROOTFS_POST_SCRIPT_ARGS="-p zynq -b uzed"
BR2_TARGET_UBOOT_BOARDNAME="zynq_microzed"
```

## board/mathworks/zynq/boards/zc702/defconfig
```kconfig
###########################################
# ZC702 Options
###########################################
BR2_TARGET_UBOOT_BOARD_DEFCONFIG="zynq_zc702"
BR2_PACKAGE_UBOOT_XILINX_UBOOT_TARGET_DIR="board/xilinx/zynq/zynq-zc702"
```

## board/mathworks/zynq/boards/zc706/defconfig
```kconfig
###########################################
# ZC706 Options
###########################################
BR2_TARGET_UBOOT_BOARD_DEFCONFIG="zynq_zc706"
BR2_PACKAGE_XILINX_BOOTLOADER_UBOOT_TARGET_DIR="board/xilinx/zynq/zynq-zc706"
```

## board/mathworks/zynq/boards/zed/defconfig
```kconfig
###########################################
# ZedBoard Options
###########################################
BR2_TARGET_UBOOT_BOARD_DEFCONFIG="zynq_zed"
BR2_PACKAGE_XILINX_BOOTLOADER_UBOOT_TARGET_DIR="board/xilinx/zynq/zynq-zed"
```

## board/mathworks/zynq/boards/zybo/defconfig
```kconfig
###########################################
# Zybo Options
###########################################
BR2_TARGET_UBOOT_BOARD_DEFCONFIG="zynq_zybo"
BR2_PACKAGE_UBOOT_XILINX_UBOOT_TARGET_DIR="board/xilinx/zynq/zynq-zybo"
```

## board/mathworks/zynq/boards/zyboz7/defconfig
```kconfig
###########################################
# Zybo Options
###########################################
BR2_TARGET_UBOOT_BOARD_DEFCONFIG="zynq_zyboz7"
BR2_PACKAGE_XILINX_BOOTLOADER_UBOOT_TARGET_DIR="board/xilinx/zynq/zynq-zyboz7"
```

## board/mathworks/zynq/boards/zyboz710/defconfig
```kconfig
###########################################
# Zybo Options
###########################################
BR2_TARGET_UBOOT_BOARD_DEFCONFIG="zynq_zybo"
BR2_PACKAGE_XILINX_BOOTLOADER_UBOOT_TARGET_DIR="board/xilinx/zynq/zynq-zybo"
```

## board/mathworks/zynq/defconfig/common.defconfig
```kconfig
###########################################
# Platform Options
###########################################
BR2_LINUX_KERNEL_CUSTOM_REPO_URL="http://github.com/mathworks/xilinx-linux.git"
BR2_LINUX_KERNEL_CUSTOM_REPO_VERSION="mathworks_zynq_R16.1.0"
BR2_LINUX_KERNEL_UIMAGE_LOADADDR="0x8000"
BR2_ROOTFS_DEVICE_TABLE="system/device_table.txt board/mathworks/zynq/device_table.txt"
BR2_ROOTFS_OVERLAY="./board/mathworks/common/fs-overlay ./board/mathworks/zynq/fs-overlay"
BR2_ROOTFS_POST_BUILD_SCRIPT="board/mathworks/zynq/scripts/postbuild_common.sh"
BR2_TARGET_GENERIC_GETTY_PORT="ttyPS0"
BR2_TARGET_GENERIC_ROOT_PASSWD="root"
BR2_TARGET_ROOTFS_CPIO_GZIP=y
BR2_TARGET_ROOTFS_CPIO=y
# BR2_TARGET_ROOTFS_TAR is not set
BR2_TARGET_UBOOT=y
BR2_TARGET_UBOOT_CUSTOM_GIT=y
BR2_TARGET_UBOOT_CUSTOM_REPO_URL="http://github.com/mathworks/xilinx-uboot.git"
BR2_TARGET_UBOOT_CUSTOM_REPO_VERSION="mathworks_zynq_R16.1.0"
BR2_TARGET_UBOOT_FORMAT_ELF=y
```

## board/mathworks/zynq/defconfig/linaro.defconfig
```kconfig
###########################################
# Linaro Toolchain Options
###########################################
BR2_TOOLCHAIN_EXTERNAL_CUSTOM=y
BR2_TOOLCHAIN_EXTERNAL_PREINSTALLED=y
BR2_TOOLCHAIN_EXTERNAL_PATH="/opt/linaro/aarch32-6.3.1-2017.02"
BR2_TOOLCHAIN_EXTERNAL_CUSTOM_PREFIX="$(ARCH)-linux-gnueabihf"
BR2_TOOLCHAIN_EXTERNAL_CUSTOM_GLIBC=y
BR2_INSTALL_LIBSTDCPP=y
BR2_TOOLCHAIN_HAS_SSP=y
BR2_TOOLCHAIN_HAS_FORTRAN=y
BR2_TOOLCHAIN_HAS_NATIVE_RPC=y
BR2_TOOLCHAIN_EXTERNAL_GCC_6=y
BR2_TOOLCHAIN_EXTERNAL_CXX=y
BR2_TOOLCHAIN_EXTERNAL_HEADERS_4_6=y
```

## board/mathworks/zynq/defconfig/linux.defconfig
```kconfig
###########################################
# Linux Options
###########################################
BR2_LINUX_KERNEL_DEFCONFIG="zynq_xcomm_adv7511"
BR2_LINUX_KERNEL_CONFIG_FRAGMENT_FILES="$(shell printenv BR2_LINUX_KERNEL_CONFIG_FRAGMENT_FILES) board/mathworks/zynq/kernel-frags/iio_dummy.frag"
```

## board/mathworks/zynq/defconfig/xilinx.defconfig
```kconfig
###########################################
# Xilinx Toolchain Options
###########################################
BR2_TOOLCHAIN_EXTERNAL_CUSTOM=y
BR2_TOOLCHAIN_EXTERNAL_PATH="/opt/Xilinx/SDK/2015.4/gnu/arm/lin"
BR2_TOOLCHAIN_EXTERNAL_CUSTOM_PREFIX="$(ARCH)-xilinx-linux-gnueabi"
BR2_TOOLCHAIN_EXTERNAL_CUSTOM_GLIBC=y
BR2_TOOLCHAIN_EXTERNAL_GCC_4_9=y
BR2_TOOLCHAIN_EXTERNAL_CXX=y
BR2_TOOLCHAIN_EXTERNAL_HEADERS_3_19=y
BR2_ARM_EABI=y
```

## board/mathworks/zynq/defconfig/zynq_common.defconfig
```kconfig
###########################################
# Platform Options
###########################################
BR2_LINUX_KERNEL_CUSTOM_REPO_VERSION="zynq-ag-next"
BR2_LINUX_KERNEL_UIMAGE_LOADADDR="0x8000"
BR2_PACKAGE_UBOOT_TGT_TOOLS=y
BR2_PACKAGE_UBOOT_TGT_TOOLS_USECUSTOMGIT=y
BR2_PACKAGE_UBOOT_TGT_TOOLS_MKIMAGE=y
BR2_PACKAGE_UBOOT_TGT_TOOLS_FWPRINTENV=y
BR2_ROOTFS_DEVICE_TABLE="system/device_table.txt board/mathworks/zynq/device_table.txt"
BR2_ROOTFS_OVERLAY="./board/mathworks/common/fs-overlay ./board/mathworks/zynq/fs-overlay"
BR2_ROOTFS_POST_BUILD_SCRIPT="board/mathworks/zynq/scripts/postbuild_common.sh"
BR2_ROOTFS_POST_IMAGE_SCRIPT="board/mathworks/zynq/scripts/postimage_common.sh"
BR2_TARGET_GENERIC_GETTY_PORT="ttyPS0"
BR2_TARGET_GENERIC_ROOT_PASSWD="root"
BR2_TARGET_ROOTFS_CPIO_GZIP=y
BR2_TARGET_ROOTFS_CPIO=y
# BR2_TARGET_ROOTFS_TAR is not set
BR2_TARGET_UBOOT_CUSTOM_REPO_VERSION="zynq-mf-next"
BR2_TARGET_UBOOT_FORMAT_ELF=y
```

## board/mathworks/zynq/defconfig/zynq_linaro.defconfig
```kconfig
###########################################
# Linaro Toolchain Options
###########################################
BR2_TOOLCHAIN_EXTERNAL_LINARO_2013_04=y
BR2_TOOLCHAIN_EXTERNAL_PREINSTALLED=y
BR2_TOOLCHAIN_EXTERNAL_PATH="/opt/xtools/linaro-2012.05"
BR2_ARM_EABIHF=y
```

## board/mathworks/zynq/defconfig/zynq_linux.defconfig
```kconfig
###########################################
# Linux Options
###########################################
BR2_LINUX_KERNEL_CUSTOM_GIT_VERSION="master"
BR2_LINUX_KERNEL_DEFCONFIG="mw_zynq"
```

## board/mathworks/zynq/defconfig/zynq_mitx-7z100.defconfig
```kconfig
###########################################
# mITX 7z100 Options
###########################################
BR2_ROOTFS_POST_SCRIPT_ARGS="-b mitx -c 7z100 -a vid-camlink -a vid-imageon -a vid-hdmi"
BR2_TARGET_UBOOT_BOARDNAME="zynq_zc70x"
BR2_LINUX_KERNEL_INTREE_DTS_NAME="zynq-mw-mitx"
```

## board/mathworks/zynq/defconfig/zynq_uzed-7z010.defconfig
```kconfig
###########################################
# ZedBoard Options
###########################################
BR2_ROOTFS_POST_SCRIPT_ARGS="-b uzed -c 7z010 -a dma"
BR2_TARGET_UBOOT_BOARDNAME="zynq_uzed"
BR2_LINUX_KERNEL_INTREE_DTS_NAME="zynq-mw-uzed"
```

## board/mathworks/zynq/defconfig/zynq_uzed.defconfig
```kconfig
###########################################
# ZedBoard Options
###########################################
BR2_ROOTFS_POST_SCRIPT_ARGS="uzed"
BR2_TARGET_UBOOT_BOARDNAME="zynq_uzed"
```

## board/mathworks/zynq/defconfig/zynq_xenomai.defconfig
```kconfig
###########################################
# Xenomai Options
###########################################
BR2_LINUX_KERNEL_DEFCONFIG="mw_xenomai_zynq"
BR2_LINUX_KERNEL_EXT_XENOMAI=y
# BR2_PACKAGE_XENOMAI_DOCS is not set
BR2_PACKAGE_XENOMAI_TESTSUITE=y
BR2_PACKAGE_XENOMAI_VXWORKS_SKIN=y
```

## board/mathworks/zynq/defconfig/zynq_xilinx.defconfig
```kconfig
###########################################
# Xilinx Toolchain Options
###########################################
BR2_TOOLCHAIN_EXTERNAL_CUSTOM=y
BR2_TOOLCHAIN_EXTERNAL_PATH="/opt/Xilinx/SDK/2014.2/gnu/arm/lin"
BR2_TOOLCHAIN_EXTERNAL_CUSTOM_PREFIX="$(ARCH)-xilinx-linux-gnueabi"
BR2_TOOLCHAIN_EXTERNAL_CUSTOM_GLIBC=y
BR2_TOOLCHAIN_EXTERNAL_CXX=y
BR2_TOOLCHAIN_EXTERNAL_HEADERS_3_11=y
```

## board/mathworks/zynq/defconfig/zynq_zc702.defconfig
```kconfig
###########################################
# ZC702 Options
###########################################
BR2_ROOTFS_POST_SCRIPT_ARGS="-b zc702 -a vid-camlink -a vid-imageon -a vid-hdmi -a vid-vita -a axilite -a axistream"
BR2_TARGET_UBOOT_BOARDNAME="zynq_zc70x"
BR2_LINUX_KERNEL_INTREE_DTS_NAME="zynq-mw-zc702"
```
