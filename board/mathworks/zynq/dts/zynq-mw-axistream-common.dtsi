#include "zynq-mw-cma.dtsi"
#include "zynq-mw-axistream-common.h"
#include "xilinx-mw-axistream-dma.dtsi"

&axi4stream_mm2s {
	reg = <0x40020000 0x10000>;
};
&axi4stream_s2mm {
	reg = <0x40030000 0x10000>;
};

&mwipcore0 {
	dmas = <&axi4stream_mm2s 0 
                &axi4stream_s2mm 0>;
	dma-names = "mm2s", "s2mm";
};
