#include "zynq-mw-cma.dtsi"
#include "adi-mw-axistream-iio-common.dtsi"

&axi4stream_mm2s {
	reg = <0x40020000 0x10000>;
	interrupts = <0x0 0x1d 0x0>;
};
&axi4stream_s2mm {
	reg = <0x40030000 0x10000>;
	interrupts = <0x0 0x1e 0x0>;
};

