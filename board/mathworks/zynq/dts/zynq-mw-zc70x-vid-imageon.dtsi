/{
    i2c_misc {
        fmceeprom {
            compatible = "mathworks,mwgeneric-v1.00";
            reg = <0x1>;    
            mwgen,type = "nomem";            
	        mwgen,devname = "fmceeprom";        
            i2c-controller = <&fmc2_eeprom>;
            
        }; 
    };
};

#define imageon_i2c i2c1

#include "zynq-mw-vid-imageon.dtsi"
