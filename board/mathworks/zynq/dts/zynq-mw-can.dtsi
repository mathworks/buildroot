&axi {
    can0: can@e0008000 {
        compatible = "xlnx,zynq-can-1.0";
        clocks = <&clkc 19>, <&clkc 36>;
        clock-names = "can_clk", "pclk";
        reg = <0xe0008000 0x1000>;
        interrupts = <0 28 4>;
        interrupt-parent = <&gic>;
        tx-fifo-depth = <0x40>;
        rx-fifo-depth = <0x40>;
        status = "disabled";
    };
};
