&axi{   
	cl2axis@42030000 {
		compatible = "mathworks,mwgeneric-v1.00";
		reg = <0x42030000 0xffff>;
		mwgen,ipname = "mathworks,cl2axis";
		mwgen,devname = "cl2axis";
		mwgen,ipinst = "cl2axis";
		mwgen,ipver = "1.00.a";
	};
};
