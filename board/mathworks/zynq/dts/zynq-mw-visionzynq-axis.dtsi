
&fpga_axi {
    mwipcore_vht2vs@43c70000 {
        compatible = "mathworks,mwipcore-v3.00";
        reg = <0x43c70000 0x10000>;
        #address-cells = <1>;
        #size-cells = <0>;

        mmwr-channel@0 {
            reg = <0x0>;
            compatible = "mathworks,mm-write-channel-v1.00";
            mathworks,dev-name = "mmwr0";
        };
    };

    mwipcore_video2vht@43c60000 {
        compatible = "mathworks,mwipcore-v3.00";
        reg = <0x43c60000 0x10000>;
    };
};
