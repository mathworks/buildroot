&fpga_axi {
				
	mwipcore1: mwipcore-rgb2ycbcr@40020000 {
		compatible = "mathworks,mwipcore-v2.00";
		reg = <0x40020000 0x10000>;
	};

	mwipcore2: mwipcore-ycbcr2rgb@40030000 {
		compatible = "mathworks,mwipcore-v2.00";
		reg = <0x40030000 0x10000>;
	};


	hdmicam_i2c: i2c@41600000 {
		compatible = "xlnx,axi-iic-1.01.b", "xlnx,xps-iic-2.00.a";
		interrupt-parent = <&intc>;
		interrupts = <0 29 0x4>;
		reg = <0x41600000 0x10000>;
		clocks = <&core_clkwiz 0>;
		clock-names = "pclk";

		#size-cells = <0>;
		#address-cells = <1>;
	};
};

#include "zynq-mw-hdmicam-common.dtsi"
