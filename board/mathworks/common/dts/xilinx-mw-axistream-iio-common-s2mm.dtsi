#include "xilinx-mw-axistream-dma-s2mm.dtsi"

&mwipcore0 {
	compatible = "mathworks,mwipcore-v3.00";
	#address-cells = <1>;
	#size-cells = <0>;
	stream-channel@1 {
		reg = <0x1>;
		#address-cells = <1>;
		#size-cells = <0>;
		compatible = "mathworks,axi4stream-s2mm-channel-v1.00";
		dma-names = "s2mm";
		dmas = <&axi4stream_s2mm 0>;
		mathworks,dev-name = "s2mm0";
		mathworks,sample-cnt-reg = <0x8>;

		data-channel@0 {
			compatible = "mathworks,iio-data-channel-v1.00";
			mathworks,data-format = "u64/64>>0";
			reg = <0x0>;
		};
	};
};

