&mwipcore0 {
	compatible = "mathworks,mwipcore-v3.00";
	#address-cells = <1>;
	#size-cells = <0>;
	
	sharedmem@0 {
		#address-cells = <1>;
		#size-cells = <0>;
		reg = <0x0>;
		compatible = "mathworks,sharedmem-v1.00";
		memory-region = <&sharedmem>;
		mathworks,dev-name = "sharedmem0";

		read-channel@0 {
			reg = <0x0>;
			compatible = "mathworks,sharedmem-read-channel-v1.00";
			mathworks,dev-name = "rd0";
		};
		
		write-channel@1 {
			reg = <0x1>;
			compatible = "mathworks,sharedmem-write-channel-v1.00";
			mathworks,dev-name = "wr0";
		};
	};
};
