#include "base.dtsi"
#include "zynqmp-mw-sharedmem-iio-common.dtsi"

/* define the PL DDR size */
#define MW_PLDDR_SIZE_1 (0x00000000)
#define MW_PLDDR_SIZE_0 (0x20000000) // 512 MB

#include "zynqmp-mw-sharedmem-iio-plmem.dtsi"

