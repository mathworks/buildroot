
&fpga_axi {
    mwipcore_vht2vs@43c70000 {
        compatible = "mathworks,mwipcore-v2.00";
        reg = <0x43c70000 0x10000>;
    };

    mwipcore_video2vht@43c60000 {
        compatible = "mathworks,mwipcore-v2.00";
        reg = <0x43c60000 0x10000>;
    };
};
