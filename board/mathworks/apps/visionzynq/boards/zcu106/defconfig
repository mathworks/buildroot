## board/mathworks/socfpga/defconfig/socfpga_linux.defconfig
```kconfig
###########################################
# Linux Options
###########################################
BR2_LINUX_KERNEL_DEFCONFIG="socfpga"
```

## board/mathworks/socfpga/defconfig/socfpga_sockit.defconfig
```kconfig
###########################################
# Terasic SoCkit Options
###########################################
BR2_ROOTFS_POST_SCRIPT_ARGS="-b sockit -a base -a dma"
BR2_LINUX_KERNEL_INTREE_DTS_NAME="socfpga_cyclone5_sockit"
BR2_PACKAGE_UBOOT_ALTERA_BOARDNAME="socfpga_cyclone5"
```

## board/mathworks/x86/boards/qemu/defconfig
```kconfig
###########################################
# x86 QEMU Options
###########################################
BR2_x86_corei7=y
BR2_TARGET_GENERIC_GETTY_PORT="ttyS0"
```

## board/mathworks/x86/defconfig/br2.defconfig
```kconfig
###########################################
# Linaro Toolchain Options
###########################################
BR2_TOOLCHAIN_BUILDROOT=y
BR2_TOOLCHAIN_BUILDROOT_GLIBC=y
BR2_TOOLCHAIN_HEADERS_AT_LEAST_4_9=y
```

## board/mathworks/x86/defconfig/common.defconfig
```kconfig
###########################################
# Platform Options
###########################################
BR2_x86_64=y
#ifdef BUILD_MODE_NORMAL
BR2_LINUX_KERNEL_CUSTOM_REPO_URL="http://insidelabs-git.mathworks.com/mfornero/linux.git"
BR2_LINUX_KERNEL_CUSTOM_REPO_VERSION="xilinx-overlay"
#endif
BR2_SYSTEM_DHCP=eth0
BR2_PACKAGE_HOST_DOSFSTOOLS=y
BR2_PACKAGE_HOST_UBOOT_TOOLS=y
BR2_ROOTFS_DEVICE_TABLE="system/device_table.txt board/mathworks/x86/device_table.txt"
BR2_ROOTFS_OVERLAY="./board/mathworks/common/fs-overlay ./board/mathworks/x86/fs-overlay"
#BR2_ROOTFS_POST_BUILD_SCRIPT="board/mathworks/x86/scripts/postbuild_common.sh"
BR2_TARGET_GENERIC_HOSTNAME="buildroot-x86mw"
BR2_TARGET_GENERIC_GETTY_PORT="tty1"
BR2_TARGET_GENERIC_ROOT_PASSWD="root"
#ifdef BUILD_MODE_NORMAL
BR2_TARGET_ROOTFS_EXT2=y
BR2_TARGET_ROOTFS_EXT2_4=y
BR2_TARGET_ROOTFS_EXT2_BLOCKS=1737280
BR2_TARGET_ROOTFS_EXT2_GEN=4
BR2_TARGET_ROOTFS_EXT2_REV=1
BR2_TARGET_ROOTFS_EXT2_LABEL="root"
BR2_TARGET_ROOTFS_EXT2_NONE=y
# BR2_TARGET_ROOTFS_TAR is not set
BR2_ECLIPSE_REGISTER=y
# BR2_PACKAGE_TCF_AGENT is not set
#endif
```

## board/mathworks/x86/defconfig/linux.defconfig
```kconfig
###########################################
# Linux Options
###########################################
BR2_LINUX_KERNEL_DEFCONFIG="mw_x86_64"
```

## board/mathworks/zynq/boards/e310/defconfig
```kconfig
###########################################
# E310 Options
###########################################
BR2_TARGET_UBOOT_BOARD_DEFCONFIG="zynq_e310"
BR2_PACKAGE_UBOOT_XILINX_UBOOT_TARGET_DIR="board/xilinx/zynq/zynq-e310"
```
