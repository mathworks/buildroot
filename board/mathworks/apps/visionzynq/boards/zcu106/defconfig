## board/mathworks/apps/visionzynq/boards/zcu106/defconfig
```kconfig
###########################################
# ZCU106 Options
###########################################
BR2_TARGET_UBOOT_BOARD_DEFCONFIG="xilinx_zynqmp_zcu106_revA"
BR2_PACKAGE_XILINX_BOOTLOADER_UBOOT_TARGET_DIR="board/xilinx/zynqmp/zynqmp-zcu106-revA"
```

## board/mathworks/apps/visionzynq/boards/zcu106_imx274/defconfig
```kconfig
###########################################
# ZCU106_IMX274 Options
###########################################
BR2_TARGET_UBOOT_BOARD_DEFCONFIG="xilinx_zynqmp_virt"
BR2_PACKAGE_XILINX_BOOTLOADER_UBOOT_TARGET_DIR="board/xilinx/zynqmp/zynqmp-zcu106-revA"

BR2_LINUX_KERNEL_CUSTOM_REPO_URL="https://github.com/mathworks/xilinx-linux.git"
BR2_LINUX_KERNEL_CUSTOM_REPO_VERSION="mathworks_zynq_vision_imx274_R23.2.0"

BR2_TARGET_UBOOT_CUSTOM_REPO_URL="https://github.com/mathworks/xilinx-uboot.git"
BR2_TARGET_UBOOT_CUSTOM_REPO_VERSION="mathworks_zynq_vision_imx274_R23.2.0"

BR2_TARGET_ARM_TRUSTED_FIRMWARE_CUSTOM_REPO_VERSION="xilinx-v2020.2"
BR2_PACKAGE_XILINX_BOOTLOADER_BOOTGEN_PATH="/opt/Xilinx/SDK/2020.2/bin/bootgen"

BR2_PACKAGE_GSTREAMER1=y
BR2_PACKAGE_GSTREAMER1_PARSE=y
BR2_PACKAGE_GSTREAMER1_PLUGIN_REGISTRY=y
BR2_PACKAGE_GSTREAMER1_INSTALL_TOOLS=y

BR2_PACKAGE_GST1_PLUGINS_BASE=y
BR2_PACKAGE_GST1_PLUGINS_BASE_PLUGIN_ADDER=y
BR2_PACKAGE_GST1_PLUGINS_BASE_PLUGIN_APP=y
BR2_PACKAGE_GST1_PLUGINS_BASE_PLUGIN_ENCODING=y
BR2_PACKAGE_GST1_PLUGINS_BASE_PLUGIN_VIDEOCONVERT=y
BR2_PACKAGE_GST1_PLUGINS_BASE_PLUGIN_SUBPARSE=y
BR2_PACKAGE_GST1_PLUGINS_BASE_PLUGIN_TCP=y
BR2_PACKAGE_GST1_PLUGINS_BASE_PLUGIN_VIDEOTESTSRC=y
BR2_PACKAGE_GST1_PLUGINS_BASE_PLUGIN_VIDEORATE=y
BR2_PACKAGE_GST1_PLUGINS_BASE_PLUGIN_VIDEOSCALE=y

BR2_PACKAGE_GST1_PLUGINS_GOOD=y
BR2_PACKAGE_GST1_PLUGINS_GOOD_JPEG=y
BR2_PACKAGE_GST1_PLUGINS_GOOD_PNG=y
BR2_PACKAGE_GST1_PLUGINS_GOOD_BZ2=y
BR2_PACKAGE_GST1_PLUGINS_GOOD_ZLIB=y
BR2_PACKAGE_GST1_PLUGINS_GOOD_PLUGIN_ALPHA=y
BR2_PACKAGE_GST1_PLUGINS_GOOD_PLUGIN_AUPARSE=y
BR2_PACKAGE_GST1_PLUGINS_GOOD_PLUGIN_AUTODETECT=y
BR2_PACKAGE_GST1_PLUGINS_GOOD_PLUGIN_AVI=y
BR2_PACKAGE_GST1_PLUGINS_GOOD_PLUGIN_CUTTER=y
BR2_PACKAGE_GST1_PLUGINS_GOOD_PLUGIN_DEBUGUTILS=y
BR2_PACKAGE_GST1_PLUGINS_GOOD_PLUGIN_DEINTERLACE=y
BR2_PACKAGE_GST1_PLUGINS_GOOD_PLUGIN_DTMF=y
BR2_PACKAGE_GST1_PLUGINS_GOOD_PLUGIN_EFFECTV=y
BR2_PACKAGE_GST1_PLUGINS_GOOD_PLUGIN_FLV=y
BR2_PACKAGE_GST1_PLUGINS_GOOD_PLUGIN_FLX=y
BR2_PACKAGE_GST1_PLUGINS_GOOD_PLUGIN_GOOM=y
BR2_PACKAGE_GST1_PLUGINS_GOOD_PLUGIN_GOOM2K1=y
BR2_PACKAGE_GST1_PLUGINS_GOOD_PLUGIN_IMAGEFREEZE=y
BR2_PACKAGE_GST1_PLUGINS_GOOD_PLUGIN_ISOMP4=y
BR2_PACKAGE_GST1_PLUGINS_GOOD_PLUGIN_MONOSCOPE=y
BR2_PACKAGE_GST1_PLUGINS_GOOD_PLUGIN_MULTIFILE=y
BR2_PACKAGE_GST1_PLUGINS_GOOD_PLUGIN_MULTIPART=y
BR2_PACKAGE_GST1_PLUGINS_GOOD_PLUGIN_RTP=y
BR2_PACKAGE_GST1_PLUGINS_GOOD_PLUGIN_RTPMANAGER=y
BR2_PACKAGE_GST1_PLUGINS_GOOD_PLUGIN_RTSP=y
BR2_PACKAGE_GST1_PLUGINS_GOOD_PLUGIN_SHAPEWIPE=y
BR2_PACKAGE_GST1_PLUGINS_GOOD_PLUGIN_SMPTE=y
BR2_PACKAGE_GST1_PLUGINS_GOOD_PLUGIN_UDP=y
BR2_PACKAGE_GST1_PLUGINS_GOOD_PLUGIN_VIDEOBOX=y
BR2_PACKAGE_GST1_PLUGINS_GOOD_PLUGIN_VIDEOCROP=y
BR2_PACKAGE_GST1_PLUGINS_GOOD_PLUGIN_VIDEOFILTER=y
BR2_PACKAGE_GST1_PLUGINS_GOOD_PLUGIN_VIDEOMIXER=y
BR2_PACKAGE_GST1_PLUGINS_GOOD_PLUGIN_Y4M=y
BR2_PACKAGE_GST1_PLUGINS_GOOD_PLUGIN_V4L2=y
BR2_PACKAGE_GST1_PLUGINS_GOOD_PLUGIN_V4L2_PROBE=y
BR2_PACKAGE_GST1_PLUGINS_GOOD_PLUGIN_GDKPIXBUF=y
BR2_PACKAGE_GST1_PLUGINS_GOOD_PLUGIN_VPX=y

BR2_PACKAGE_YAVTA=y
```

## board/mathworks/apps/visionzynq/defconfig/vzcommon.defconfig
```kconfig
###########################################
# Linux 4.4
###########################################
BR2_LINUX_KERNEL_CUSTOM_REPO_URL="http://insidelabs-git.mathworks.com/jchevali/xilinx-linux.git"
BR2_LINUX_KERNEL_CUSTOM_REPO_VERSION="mathworks_zynq_vision_R17.1.0"
```

## board/mathworks/apps/zynqsdr/boards/adrv9361/defconfig
```kconfig
###########################################
# ZC706 Options
###########################################
BR2_TARGET_UBOOT_BOARD_DEFCONFIG="zynq_picozed_sdr2"
BR2_PACKAGE_XILINX_BOOTLOADER_UBOOT_TARGET_DIR="board/xilinx/zynq/zynq-picozed-sdr2"
```

## board/mathworks/apps/zynqsdr/boards/e310/defconfig
```kconfig
###########################################
# E310 Options
###########################################
BR2_TARGET_UBOOT_BOARD_DEFCONFIG="zynq_e310"
BR2_PACKAGE_XILINX_BOOTLOADER_UBOOT_TARGET_DIR="board/xilinx/zynq/zynq-e310"
###########################################
# Linux Options
###########################################
BR2_LINUX_KERNEL_DEFCONFIG="zynq_e310"
BR2_LINUX_KERNEL_CONFIG_FRAGMENT_FILES="$(shell printenv BR2_LINUX_KERNEL_CONFIG_FRAGMENT_FILES) board/mathworks/zynq/kernel-frags/iio_dummy.frag"
```

## board/mathworks/common/defconfig/aarch64_common.defconfig
```kconfig
###########################################
# Common Options
###########################################
BR2_aarch64=y
#BR2_ARM_ENABLE_NEON=y
#BR2_ARM_FPU_NEON=y
#BR2_ARM_ENABLE_VFP=y
```

## board/mathworks/common/defconfig/arm_common.defconfig
```kconfig
###########################################
# Common Options
###########################################
BR2_arm=y
BR2_cortex_a9=y
BR2_ARM_ENABLE_NEON=y
BR2_ARM_FPU_NEON=y
BR2_ARM_ENABLE_VFP=y
```

## board/mathworks/common/defconfig/common.defconfig
```kconfig
###########################################
# Common Options
###########################################
BR2_ENABLE_LOCALE_PURGE=y
BR2_ENABLE_LOCALE_WHITELIST="C en_US"
# BR2_LINUX_KERNEL_DTS_SUPPORT is not set
# BR2_LINUX_KERNEL_USE_INTREE_DTS is not set
BR2_TARGET_TZ_INFO=y
#ifdef BUILD_MODE_NORMAL
BR2_LINUX_KERNEL=y
BR2_LINUX_KERNEL_CUSTOM_GIT=y
#else
# BR2_LINUX_KERNEL is not set
# BR2_LINUX_KERNEL_CUSTOM_GIT is not set
#endif
BR2_PACKAGE_BUSYBOX_CONFIG="board/mathworks/common/busybox_config"
#ifdef BUILD_MODE_NORMAL
BR2_ROOTFS_POST_IMAGE_SCRIPT="board/mathworks/common/scripts/postimage_common.py"
#endif

#ifdef BUILD_MODE_NORMAL
###########################################
# Packages for user-mode image
###########################################
BR2_PACKAGE_ALSA_UTILS=y
BR2_PACKAGE_ALSA_UTILS_ALSACONF=y
BR2_PACKAGE_ALSA_UTILS_ALSACTL=y
BR2_PACKAGE_ALSA_UTILS_ALSAMIXER=y
BR2_PACKAGE_ALSA_UTILS_AMIXER=y
BR2_PACKAGE_ALSA_UTILS_APLAY=y
BR2_PACKAGE_ALSA_UTILS_ACONNECT=y
BR2_PACKAGE_ALSA_UTILS_SPEAKER_TEST=y
BR2_PACKAGE_ALSA_LIB=y
BR2_PACKAGE_ALSA_LIB_DEVDIR="/dev/snd"
BR2_PACKAGE_ALSA_LIB_PCM_PLUGINS="all"
BR2_PACKAGE_ALSA_LIB_CTL_PLUGINS="all"
BR2_PACKAGE_ALSA_LIB_ALOAD=y
BR2_PACKAGE_ALSA_LIB_MIXER=y
BR2_PACKAGE_ALSA_LIB_PCM=y
BR2_PACKAGE_ALSA_LIB_RAWMIDI=y
BR2_PACKAGE_ALSA_LIB_HWDEP=y
BR2_PACKAGE_ALSA_LIB_SEQ=y
BR2_PACKAGE_ALSA_LIB_ALISP=y
BR2_PACKAGE_ALSA_LIB_OLD_SYMBOLS=y
BR2_PACKAGE_LIBSERIAL=y
BR2_PACKAGE_LIBUSB=y
BR2_PACKAGE_LIBUSB_COMPAT=y
BR2_PACKAGE_BOOST=y
BR2_PACKAGE_BOOST_CHRONO=y
BR2_PACKAGE_BOOST_CONTEXT=y
BR2_PACKAGE_BOOST_DATE_TIME=y
BR2_PACKAGE_BOOST_EXCEPTION=y
BR2_PACKAGE_BOOST_FILESYSTEM=y
BR2_PACKAGE_BOOST_GRAPH=y
BR2_PACKAGE_BOOST_GRAPH_PARALLEL=y
BR2_PACKAGE_BOOST_IOSTREAMS=y
BR2_PACKAGE_BOOST_LOCALE=y
BR2_PACKAGE_BOOST_MATH=y
BR2_PACKAGE_BOOST_MPI=y
BR2_PACKAGE_BOOST_PROGRAM_OPTIONS=y
BR2_PACKAGE_BOOST_RANDOM=y
BR2_PACKAGE_BOOST_REGEX=y
BR2_PACKAGE_BOOST_SERIALIZATION=y
BR2_PACKAGE_BOOST_SYSTEM=y
BR2_PACKAGE_BOOST_TEST=y
BR2_PACKAGE_BOOST_THREAD=y
BR2_PACKAGE_BOOST_TIMER=y
BR2_PACKAGE_BOOST_WAVE=y
BR2_PACKAGE_CAN_UTILS=y
BR2_PACKAGE_LIBV4L=y
BR2_PACKAGE_LIBV4L_UTILS=y
BR2_PACKAGE_LIBDRM=y
BR2_PACKAGE_LIBDRM_INSTALL_TESTS=y
BR2_PACKAGE_OPENCV4=y
BR2_PACKAGE_OPENCV4_WITH_V4L=y
BR2_PACKAGE_IPERF=y
BR2_PACKAGE_IPERF3=y
BR2_PACKAGE_LIBIIO=y
BR2_PACKAGE_LIBIIO_TESTS=y
BR2_PACKAGE_SOCKETCAND=y
BR2_PACKAGE_THTTPD=y
BR2_TOOLCHAIN_EXTERNAL_GDB_SERVER_COPY=y
BR2_PACKAGE_TCF_AGENT=y
BR2_PACKAGE_NTP_NTPDATE=y
BR2_PACKAGE_NTP_NTP_KEYGEN=y
BR2_PACKAGE_NTP_SNTP=y
BR2_PACKAGE_NTP_TICKADJ=y
BR2_PACKAGE_NTP=y
#endif

#ifdef BUILD_MODE_RECOVERY
# Turn this on for recovery builds, when we're not building u-boot itself
BR2_PACKAGE_HOST_UBOOT_TOOLS=y
# Build a RAMDISK for recovery
BR2_TARGET_ROOTFS_CPIO_GZIP=y
BR2_TARGET_ROOTFS_CPIO=y
BR2_TARGET_ROOTFS_CPIO_UIMAGE=y
#endif

###########################################
# Packages for all images
###########################################
BR2_PACKAGE_DTC_PROGRAMS=y
BR2_PACKAGE_DTC=y
BR2_PACKAGE_HOST_DTC=y
BR2_PACKAGE_HOST_E2FSPROGS=y
BR2_PACKAGE_HOST_GENEXT2FS=y
BR2_PACKAGE_HOST_GENIMAGE=y
BR2_PACKAGE_I2C_TOOLS=y
BR2_PACKAGE_OPENSSH=y
BR2_PACKAGE_XINETD=y
BR2_ROOTFS_DEVICE_CREATION_DYNAMIC_MDEV=y
# BR2_TARGET_GENERIC_REMOUNT_ROOTFS_RW is not set

BR2_TOOLCHAIN_EXTERNAL=y
BR2_PACKAGE_IPROUTE2=y
BR2_PACKAGE_NCURSES=y
BR2_PACKAGE_NCURSES_TARGET_PANEL=y
BR2_PACKAGE_NCURSES_TARGET_FORM=y
BR2_PACKAGE_NCURSES_TARGET_MENU=y
BR2_PACKAGE_RSYNC=y
BR2_PACKAGE_UBOOT_TOOLS=y
BR2_PACKAGE_UBOOT_TOOLS_MKIMAGE=y
BR2_PACKAGE_UBOOT_TOOLS_FWPRINTENV=y
BR2_PACKAGE_DOSFSTOOLS=y
BR2_PACKAGE_DOSFSTOOLS_FSCK_FAT=y
BR2_PACKAGE_DOSFSTOOLS_MKFS_FAT=y
BR2_PACKAGE_E2FSPROGS=y
BR2_PACKAGE_E2FSPROGS_MKE2FS=y
BR2_PACKAGE_E2FSPROGS_E2FSCK=y

BR2_PACKAGE_UTIL_LINUX=y
BR2_PACKAGE_UTIL_LINUX_LIBBLKID=y
BR2_PACKAGE_UTIL_LINUX_LIBMOUNT=y
BR2_PACKAGE_UTIL_LINUX_LIBSMARTCOLS=y
BR2_PACKAGE_UTIL_LINUX_LIBUUID=y
BR2_PACKAGE_UTIL_LINUX_BINARIES=y

# Enable LTTNG
BR2_PACKAGE_LTTNG_BABELTRACE=y
BR2_PACKAGE_LTTNG_MODULES=y
BR2_PACKAGE_LTTNG_TOOLS=y
BR2_PACKAGE_LTTNG_LIBUST=y
```

## board/mathworks/socfpga/boards/alteracycv/defconfig
```kconfig
###########################################
# Altera Cyclone V Dev Kit Options
###########################################
BR2_TARGET_UBOOT_BOARDNAME="socfpga_cyclone5"
BR2_PACKAGE_UBOOT_ALTERA_BSP_OPTIONS="--set spl.boot.FAT_SUPPORT True --set spl.boot.SDRAM_SCRUBBING True --set spl.boot.SDRAM_SCRUB_REMAIN_REGION True"
BR2_TARGET_UBOOT_FORMAT_IMG=y
BR2_TARGET_UBOOT_SPL=y
BR2_TARGET_UBOOT_ALTERA_SOCFPGA_IMAGE_CRC=y
# BR2_TARGET_UBOOT_BOARD_DEFCONFIG="socfpga_cyclone5"
```

## board/mathworks/socfpga/boards/arria10/defconfig
```kconfig
###########################################
# Arria 10 SoC Dev Kit Options
###########################################
# BSP custom commands for Arria 10
BR2_PACKAGE_UBOOT_ALTERA_GENERATE_ARRIA10_UBOOT=y
BR2_TARGET_UBOOT_BOARDNAME="socfpga_cyclone5"
BR2_PACKAGE_UBOOT_ALTERA_BSP_OPTIONS=" --set uboot.rbf_filename socfpga.periph.rbf "
# Custom UBOOT configuration for Arria 10
#BR2_TARGET_UBOOT_FORMAT_CUSTOM=y
#BR2_TARGET_UBOOT_FORMAT_CUSTOM_NAME="uboot_w_dtb-mkpimage.bin"
#BR2_TARGET_UBOOT_BUILD_SYSTEM_KCONFIG=y
#BR2_TARGET_UBOOT_BOARD_DEFCONFIG="socfpga_arria10"
#BR2_TARGET_UBOOT_FORMAT_DTB_BIN=y
#BR2_TARGET_UBOOT_FORMAT_DTB_IMG=y
```

## board/mathworks/socfpga/boards/recovery/defconfig
```kconfig
BR2_ROOTFS_OVERLAY="./board/mathworks/common/fs-overlay ./board/mathworks/socfpga/fs-overlay ./board/mathworks/socfpga/boards/recovery/fs-overlay"
```

## board/mathworks/socfpga/boards/sockit/defconfig
```kconfig
###########################################
# Terasic SoCkit Options
###########################################
BR2_TARGET_UBOOT_BOARDNAME="socfpga_cyclone5"
BR2_PACKAGE_UBOOT_ALTERA_BSP_OPTIONS="--set spl.boot.FAT_SUPPORT True"
BR2_TARGET_UBOOT_FORMAT_IMG=y
BR2_TARGET_UBOOT_SPL=y
BR2_TARGET_UBOOT_ALTERA_SOCFPGA_IMAGE_CRC=y
# BR2_TARGET_UBOOT_BOARD_DEFCONFIG="socfpga_sockit"
```

## board/mathworks/socfpga/defconfig/common.defconfig
```kconfig
###########################################
# Platform Options
###########################################
#include "arm_common.defconfig"
#ifdef BUILD_MODE_NORMAL
BR2_LINUX_KERNEL_CUSTOM_REPO_URL="https://github.com/mathworks/altera-linux.git"
BR2_LINUX_KERNEL_CUSTOM_REPO_VERSION="mathworks_socfpga_R21.2.0"
# BR2_LINUX_KERNEL_UIMAGE is not set
BR2_LINUX_KERNEL_ZIMAGE=y
#endif
BR2_PACKAGE_HOST_DOSFSTOOLS=y
BR2_PACKAGE_HOST_UBOOT_TOOLS=y
BR2_ROOTFS_DEVICE_TABLE="system/device_table.txt board/mathworks/socfpga/device_table.txt"
BR2_ROOTFS_OVERLAY="./board/mathworks/common/fs-overlay ./board/mathworks/socfpga/fs-overlay"
BR2_ROOTFS_POST_BUILD_SCRIPT="board/mathworks/socfpga/scripts/postbuild_common.sh"
BR2_TARGET_GENERIC_HOSTNAME="buildroot-socfpga"
BR2_TARGET_GENERIC_GETTY_PORT="ttyS0"
BR2_TARGET_GENERIC_ROOT_PASSWD="cyclonevsoc"
#ifdef BUILD_MODE_NORMAL
BR2_TARGET_ROOTFS_EXT2=y
BR2_TARGET_ROOTFS_EXT2_4=y
BR2_TARGET_ROOTFS_EXT2_BLOCKS=737280
BR2_TARGET_ROOTFS_EXT2_GEN=4
BR2_TARGET_ROOTFS_EXT2_REV=1
BR2_TARGET_ROOTFS_EXT2_LABEL="root"
BR2_TARGET_ROOTFS_EXT2_NONE=y
BR2_TARGET_ROOTFS_TAR=y
BR2_TARGET_ROOTFS_TAR_GZIP=y
BR2_TARGET_UBOOT=y
BR2_TARGET_UBOOT_CUSTOM_GIT=y
BR2_TARGET_UBOOT_CUSTOM_REPO_URL="https://github.com/mathworks/altera-uboot.git"
BR2_TARGET_UBOOT_CUSTOM_REPO_VERSION="mathworks_socfpga_R20.2.0"
# BR2_TARGET_UBOOT_BUILD_SYSTEM_KCONFIG=y
BR2_PACKAGE_UBOOT_ALTERA=y
BR2_PACKAGE_UBOOT_ALTERA_EDS_VERSION="17.0.0.155"
BR2_PACKAGE_UBOOT_ALTERA_EDS_INSTALLATION="/opt/intelFPGA/17.0/embedded"
BR2_PACKAGE_RECOVERY_IMAGE=y
BR2_PACKAGE_RECOVERY_IMAGE_PLATFORM="socfpga"
BR2_PACKAGE_RECOVERY_IMAGE_BOARD="recovery"
#endif
```

## board/mathworks/socfpga/defconfig/linaro.defconfig
```kconfig
###########################################
# Linaro Toolchain Options
###########################################
BR2_TOOLCHAIN_EXTERNAL_CUSTOM=y
BR2_ARM_EABIHF=y
BR2_TOOLCHAIN_EXTERNAL_PREINSTALLED=y
BR2_TOOLCHAIN_EXTERNAL_PATH="/opt/altera/15.0/embedded/ds-5/sw/gcc/"
BR2_TOOLCHAIN_EXTERNAL_CUSTOM_PREFIX="$(ARCH)-linux-gnueabihf"
BR2_TOOLCHAIN_EXTERNAL_CUSTOM_GLIBC=y
BR2_INSTALL_LIBSTDCPP=y
BR2_TOOLCHAIN_HAS_NATIVE_RPC=y
BR2_TOOLCHAIN_EXTERNAL_GCC_4_8=y
BR2_TOOLCHAIN_EXTERNAL_CXX=y
BR2_TOOLCHAIN_EXTERNAL_HEADERS_3_1=y
```

## board/mathworks/socfpga/defconfig/linux.defconfig
```kconfig
###########################################
# Linux Options
###########################################
BR2_LINUX_KERNEL_DEFCONFIG="mw_socfpga"
```

## board/mathworks/socfpga/defconfig/socfpga_alteracycv.defconfig
```kconfig
###########################################
# Altera Cyclone V Dev Kit Options
###########################################
BR2_ROOTFS_POST_SCRIPT_ARGS="-b alteracycv -a base"
BR2_LINUX_KERNEL_INTREE_DTS_NAME="socfpga_cyclone5_socdk"
BR2_PACKAGE_UBOOT_ALTERA_BOARDNAME="socfpga_cyclone5"
BR2_PACKAGE_ALTERA_PRELOADER_QUARTUS_HANDOFF_DIR="board/mathworks/socfpga/boards/alteracycv/handoff"
```

## board/mathworks/socfpga/defconfig/socfpga_common.defconfig
```kconfig
###########################################
# Platform Options
###########################################
BR2_LINUX_KERNEL_CUSTOM_REPO_URL="http://insidelabs-git.mathworks.com/mfornero/linux.git"
BR2_LINUX_KERNEL_CUSTOM_REPO_VERSION="altera"
# BR2_LINUX_KERNEL_UIMAGE is not set
BR2_LINUX_KERNEL_ZIMAGE=y
BR2_PACKAGE_HOST_DOSFSTOOLS=y
BR2_PACKAGE_HOST_UBOOT_TOOLS=y
BR2_ROOTFS_DEVICE_TABLE="system/device_table.txt board/mathworks/socfpga/device_table.txt"
BR2_ROOTFS_OVERLAY="./board/mathworks/common/fs-overlay ./board/mathworks/socfpga/fs-overlay"
BR2_ROOTFS_POST_BUILD_SCRIPT="board/mathworks/socfpga/scripts/postbuild_common.sh"
BR2_ROOTFS_POST_IMAGE_SCRIPT="board/mathworks/socfpga/scripts/postimage_common.sh"
BR2_TARGET_GENERIC_GETTY_PORT="ttyS0"
BR2_TARGET_GENERIC_ROOT_PASSWD="cyclonevsoc"
BR2_TARGET_ROOTFS_TAR_GZIP=y
BR2_TARGET_ROOTFS_TAR=y
BR2_TARGET_UBOOT_CUSTOM_REPO_URL="http://insidelabs-git.mathworks.com/mfornero/uboot.git"
BR2_TARGET_UBOOT_CUSTOM_REPO_VERSION="altera"
BR2_TARGET_UBOOT_FORMAT_IMG=y
```

## board/mathworks/socfpga/defconfig/socfpga_linaro.defconfig
```kconfig
###########################################
# Linaro Toolchain Options
###########################################
BR2_TOOLCHAIN_EXTERNAL_CUSTOM=y
BR2_TOOLCHAIN_EXTERNAL_CXX=y
BR2_TOOLCHAIN_EXTERNAL_CUSTOM_GLIBC=y
BR2_TOOLCHAIN_EXTERNAL_CUSTOM_PREFIX="$(ARCH)-linux-gnueabihf"
BR2_TOOLCHAIN_EXTERNAL_PATH="/opt/altera/13.1/embedded/ds-5/sw/gcc/"
BR2_ARM_EABIHF=y
BR2_TOOLCHAIN_EXTERNAL_HEADERS_3_2=y
```
