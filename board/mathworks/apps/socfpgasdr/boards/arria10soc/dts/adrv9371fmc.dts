/dts-v1/;

//#include "socfpga_arria10_socdk_sdmmc.dts"
#include "socfpga_arria10_socdk_adrv9371.dts"
/*

&eccmgr {
	sdmmca-ecc@ff8c2c00 {
		compatible = "altr,socfpga-sdmmc-ecc";
		reg = <0xff8c2c00 0x400>;
		altr,ecc-parent = <&mmc>;
		interrupts = <15 IRQ_TYPE_LEVEL_HIGH>,
			     <47 IRQ_TYPE_LEVEL_HIGH>,
			     <16 IRQ_TYPE_LEVEL_HIGH>,
			     <48 IRQ_TYPE_LEVEL_HIGH>;
	};
};


//add these later after you modify the Qsys project?
#include "socfpga-mw-fpga-bridge.dtsi"
#include "socfpga-mw-mwipcore.dtsi"
/ {
    	chosen {
		bootargs = "console=ttyS0,115200 root=/dev/mmcblk0p3 rw rootwait earlyprintk";
	};
};

/delete-node/ &fpga2sdram0;

*/
