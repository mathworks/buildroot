#include "zynq-mw-axistream-iio-common.dtsi"

&axi4stream_mm2s {
	reg = <0x40020000 0x10000>;
	clocks = <&adc0_ad9361 0 &adc0_ad9361 0 &adc0_ad9361 0>;
	dma-channel@0  {
		interrupts = <0x0 0x1d 0x4>;
	};	
};

&axi4stream_s2mm {
	reg = <0x40030000 0x10000>;
	clocks = <&adc0_ad9361 0 &adc0_ad9361 0 &adc0_ad9361 0>;
	dma-channel@0  {
		interrupts = <0x0 0x1e 0x4>;
	};
};

