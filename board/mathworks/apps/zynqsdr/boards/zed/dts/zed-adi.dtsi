&fpga_axi {
	fmc_i2c: i2c@41620000 {
		compatible = "xlnx,axi-iic-1.01.b", "xlnx,xps-iic-2.00.a";
		reg = <0x41620000 0x10000>;
		interrupt-parent = <&intc>;
		interrupts = <0 55 0x4>;
		clocks = <&clkc 15>;
		clock-names = "pclk";

		#size-cells = <0>;
		#address-cells = <1>;
	};
};
