#include "zynq-mw-vid-common.dtsi"

&hdmitx{
    mwgen,vidinjust = "left";
	mwgen,vidembedsync;
};
	
&i2c0{			
    status = "okay";
	
	adv7511: adv7511@39 {
		compatible = "mwadi,mwadv7511";
		reg = <0x39>;

		adi,input-style = <0x02>;
		adi,input-id = <0x02>;
		adi,input-color-depth = <0x3>;
		adi,sync-pulse = <0x03>;
		adi,bit-justification = <0x02>;
		adi,up-conversion = <0x00>;
		adi,timing-generation-sequence = <0x00>;
		adi,vsync-polarity = <0x02>;
		adi,hsync-polarity = <0x02>;
		adi,tdms-clock-inversion;
		adi,clock-delay = <0x03>;
	};
};

