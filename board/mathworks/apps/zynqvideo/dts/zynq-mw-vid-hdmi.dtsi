#include "zynq-mw-vid-imageon.dtsi"

&fpga_axi{   
	hdmirx@41000000 {
		compatible = "mathworks,mwgeneric-v1.00";
		reg = <0x41000000 0xffff>;
		mwgen,ipname = "adi,axi_hdmi_rx";
		mwgen,devname = "hdmirx";
		mwgen,ipinst = "axi_hdmi_rx";
		mwgen,ipver = "1.0";
        i2c-controller = <&adv7611>;
	};

    dmac2vdma@41020000 {
		compatible = "mathworks,mwgeneric-v1.00";
		reg = <0x41020000 0xffff>;
		mwgen,ipname = "mw,dmac_to_vdma";
		mwgen,devname = "dmac2vdma";
		mwgen,ipinst = "dmac_to_vdma";
		mwgen,ipver = "1.0";
	};
};

