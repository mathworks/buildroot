&fpga_axi {
	mwipcore_hdmi_in@43c20000 {
		compatible = "mathworks,mwipcore-v3.00";
		reg = <0x43c20000 0x10000>;
		#address-cells = <1>;
		#size-cells = <0>;

		mmwr-channel@0 {
			reg = <0x0>;
			compatible = "mathworks,mm-write-channel-v1.00";
			mathworks,dev-name = "mmwr0";
		};
	};
};

