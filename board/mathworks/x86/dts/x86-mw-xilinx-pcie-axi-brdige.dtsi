/dts-v1/;
/plugin/;
/{
    fragment {
        target-path = "/system";
        /* suppress DTC warning */
        #address-cells = <2>;
        #size-cells = <1>;
        __overlay__ {
            /* suppress DTC warning */
            #address-cells = <2>;
            #size-cells = <1>;
            ranges;
            compatible = "simple-bus";
            
            fpga_pcie_bar: pcie_bridge@c0000000 {
                ranges = <0x0 0x0 0x0 0xc0000000 0x20000000>;
                #size-cells = <0x1>;
                #address-cells = <0x2>;
                #interrupt-cells = <0x2>;
                reg = <0x0 0xc0000000 0x20000000>;
                compatible = "xlnx,pcie-axi-bridge", "simple-bus";
                interrupt-controller;
            };
        };
    };
};
