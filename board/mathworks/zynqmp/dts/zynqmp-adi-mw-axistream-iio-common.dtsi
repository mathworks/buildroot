#include "zynqmp-mw-cma.dtsi"
#include "adi-mw-axistream-iio-common.dtsi"

&axi4stream_mm2s {
	reg = <0xA0020000 0x10000>;
	interrupts = <0x0 89 0x0>;
};
&axi4stream_s2mm {
	reg = <0xA0030000 0x10000>;
	interrupts = <0x0 90 0x0>;
};
