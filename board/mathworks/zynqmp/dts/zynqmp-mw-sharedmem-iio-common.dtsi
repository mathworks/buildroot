/ {
	memory_reserved: reserved-memory {
		#address-cells = <2>;
		#size-cells = <2>;
		ranges;
		
		sharedmem: region@14000000 {
			reg = <0x0 0x14000000 0x0 0x4000000>;
			no-map;
		};
	};
};

#include "mw-sharedmem-iio-common.dtsi"
