#include "zynqmp-zcu102-rev1.0.dts"

/ {
	chosen {
		bootargs = "earlycon root=/dev/ram rw";
	};
};
#include "zynqmp-mw-fpga-bridge-common.dtsi"
#include "zynqmp-mw-common.dtsi"
#include "mw-aximm-common.dtsi"
