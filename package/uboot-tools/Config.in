## package/uboot-tools/Config.in
```kconfig
config BR2_PACKAGE_UBOOT_TOOLS
	bool "u-boot tools"
	help
	  Companion tools for Das U-Boot bootloader.

	  http://www.denx.de/wiki/U-Boot/WebHome

if BR2_PACKAGE_UBOOT_TOOLS

config BR2_PACKAGE_UBOOT_TOOLS_USECUSTOMGIT
    bool "Use Custom Git"
    depends on BR2_TARGET_UBOOT_CUSTOM_GIT
    help
	  Use the custom git repository defined for the bootloader

config BR2_PACKAGE_UBOOT_TOOLS_USEBOARDCONFIG
    bool "Use Board Config"
    help
      Use the board-specific config for building u-boot tools        

config BR2_PACKAGE_UBOOT_TOOLS_MKIMAGE
	bool "mkimage"
	help
	  The mkimage tool from Das U-Boot bootloader, which allows
	  generation of U-Boot images in various formats.

config BR2_PACKAGE_UBOOT_TOOLS_MKENVIMAGE
	bool "mkenvimage"
	help
	  The mkenvimage tool from Das U-Boot bootloader, which allows
	  generation of a valid binary environment image from a text file
	  describing the key=value pairs of the environment.

config BR2_PACKAGE_UBOOT_TOOLS_FWPRINTENV
	bool "fw_printenv"
	default y
	help
	  The fw_printenv / fw_setenv tools from Das U-Boot
	  bootloader, which allows access to the U-Boot environment
	  from Linux.

endif
```
